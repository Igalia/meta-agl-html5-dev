## conf/layer.conf
```bitbake
# We have a conf and classes directory, add to BBPATH
BBPATH =. "${LAYERDIR}:"

# We have recipes-* directories, add to BBFILES
BBFILES += "${LAYERDIR}/recipes-*/*/*.bb \
            ${LAYERDIR}/recipes-*/*/*.bbappend"

BBFILE_COLLECTIONS += "agl-html5-dev"
BBFILE_PATTERN_agl-html5-dev = "^${LAYERDIR}/"
BBFILE_PRIORITY_agl-html5-dev = "7"

LAYERSERIES_COMPAT_agl-html5-dev = "dunfell"

PNBLACKLIST[chromium68] = "We should use chromium79"
PNBLACKLIST[chromium-browser-service] = "Not ported to chromium79"
```
